/dts-v1/;
/plugin/;
/ {
	compatible = "brcm,bcm2835";
	fragment@0 {
		target = <&i2c1>;
		__overlay__ {
			#address-cells = <1>;
			#size-cells = <0>;

			pim479: pim479@60 {
				compatible = "motor,pim479";
				reg = <0x60>;
				status = "okay";
			};
		};
	};
};