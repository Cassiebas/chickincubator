/dts-v1/;
/plugin/;
/ {
	compatible = "brcm,bcm2835";
	fragment@0 {
		target = <&i2c1>;
		__overlay__ {
			#address-cells = <1>;
			#size-cells = <0>;

			ssd1306: ssd1306@3C {
				compatible = "display,ssd1306";
				reg = <0x3C>;
				status = "okay";
			};
		};
	};
};